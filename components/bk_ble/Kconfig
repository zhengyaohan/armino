## components/bk_ble/Kconfig
```kconfig
menu "BLE"
	config BLE
		depends on BLUETOOTH
		bool "Enable Bluetooth Low Energy"
		default y

	choice BLE_STACK
		prompt "BLE Version"
		depends on BLE
		default BLE_5_X

		config BLE_5_X
			bool "BLE 5.X"
		config BLE_4_2
			bool "BLE 4.2"
		config BTDM_5_2
			bool "BTDM 5.2"
	endchoice

	choice BLE_HOST
		prompt "BLE Host Type"
		default BLE_HOST_RW

		config BLE_HOST_NONE
			bool "BLE Host None"

		config BLE_HOST_RW
			bool "BLE Host RW"

		config BLE_HOST_ZEPHYR
			bool "BLE Host Zephyr"
	endchoice
endmenu
```

## components/demos/media/audio/audio_transfer/Kconfig
```kconfig
menu "AUD_TRAS_CONFIG"
	config AUDIO_TRANSFER
		bool "Enable Audio Transfer Feature"
		default n

	choice AUD_TRAS_MODE
		prompt "Audio Transfer Mode"
		default AUD_TRAS_MODE_CPU1

		config AUD_TRAS_MODE_CPU0
			depends on AUDIO_TRANSFER
			bool "Audio Transfer in CPU0"

		config AUD_TRAS_MODE_CPU1
			depends on AUDIO_TRANSFER
			bool "Audio Transfer in CPU1"

	endchoice

	config AUD_TRAS_AEC_DUMP_DEBUG
			depends on AUDIO_TRANSFER
			bool "enable Audio Transfer AEC dump debug"
			default n

	config AUD_TRAS_LOST_COUNT_DEBUG
			depends on AUDIO_TRANSFER
			bool "enable Audio Transfer lost count debug"
			default n

endmenu
```

## components/demos/media/audio/audio_transfer_apk/Kconfig
```kconfig
menu "DEMOS_CONFIG"
	config AUDIO_TRANSFER_APK
		bool "Enable Audio transfer apk demo test"
		default n
endmenu
```

## components/demos/media/audio/audio_transfer_cpu0_mode/Kconfig
```kconfig
menu "DEMOS_CONFIG"
	config AUDIO_TRANSFER_CPU0
		bool "Enable Audio transfer cpu0 mode test"
		default n
endmenu
```

## components/demos/media/audio/audio_transfer_sd/Kconfig
```kconfig
menu "DEMOS_CONFIG"
	config AUDIO_TRANSFER_SD
		bool "Enable Audio transfer sd demo test"
		default n
endmenu
```

## components/homekit/Kconfig
```kconfig
#TODO add depens for CONFIG_HOST (bk7231u)
menu "HOMEKIT CONFIG"
	config HOMEKIT
		bool "Enable HOMEKIT"
		default n
endmenu
```

## components/http/Kconfig
```kconfig
menu "HTTP_CONFIG"
	config HTTP
		bool "Enable http"
		default y

	config HTTP_OTA_WITH_BLE
		bool "Disable http ota with ble"
		default n
endmenu
```

## components/matter/Kconfig
```kconfig
menu "matter config"

	config MATTER_APP
		string "matter app"
		default "lighting-app"
endmenu
```

## components/music_player/Kconfig
```kconfig
config MP3PLAYER
	bool "Enable MP3 Player"
	default n

menu "MP3 Player"
	depends on MP3PLAYER

	config TASK_MEDIA_PRIO
		int "Priority of Media task"
		range 1 10
		default 4

endmenu
```

## components/paho-mqtt/Kconfig
```kconfig
menu "PAHO_MQTT_CONFIG"
	config PAHO_MQTT
		bool "Enable paho-mqtt"
		default y
endmenu
```

## components/sim_uart/Kconfig
```kconfig
menu "SIM_UART_CONFIG"
	config SIM_UART
		bool "Enable sim uart"
		default y
endmenu
```

## components/udisk_mp3/Kconfig
```kconfig
config UDISK_MP3
	bool "Enable USB Disk MP3"
	default n

menu "USB Disk MP3"
	depends on UDISK_MP3

	config TASK_UMP3_PRIO
		int "Priority of USB MP3 task"
		range 1 10
		default 4
endmenu
```

## components/usb_plug/Kconfig
```kconfig
config USB_PLUG_IN_OUT
	depends on USB
	bool "Enable USB Plug In Out"
	default n
```

## components/wolfssl/Kconfig
```kconfig
menu "WOLFSSL"

	config WOLFSSL_BEKEN
		bool "Enable WOLFSSL_BEKEN"
		default n if !WPA3
		default y if WPA3

endmenu
```

## middleware/arch/bk7231u/bk7231u.defconfig
```kconfig
#The value config in bk7231u.defconfig will over write the Kconfig's default value.
#If the default value in Kconfig satisfy your needs, then you needn't to config again here.

CONFIG_SOC_BK7231U=y
CONFIG_SOC_STR="bk7231u"

#
# BDK Configuration
#

#
# Common Configuration
#

#
# Compile/Build
#

#
# Debug
#
CONFIG_DEBUG_FIRMWARE=y
CONFIG_ASSERT_IGNORE=y
# CONFIG_ASSERT_HALT is not set
# CONFIG_ASSERT_REBOOT is not set
# CONFIG_JTAG is not set
# end of Debug
# end of Common Configuration

#
# Features Configuration
#
CONFIG_LWIP_V2_0=y
# CONFIG_LWIP_V2_1 is not set
CONFIG_NO_HOSTED=y
# CONFIG_SEMI_HOSTED is not set
# CONFIG_FULLY_HOSTED is not set
# CONFIG_WIFI_SENSOR is not set
# end of Features Configuration

#
# Components Configuration
#

#
# Application
#
# CONFIG_DEMO_TEST is not set
# CONFIG_FTPD_UPGRADE is not set
CONFIG_OTA_HTTP=y
# CONFIG_OTA_TFTP is not set
# end of Application

# CONFIG_AT is not set
CONFIG_AT_CMD=y

#
# Audio
#
# end of Audio

#
# Calibration
#
CONFIG_CALI=y
CONFIG_MANUAL_CALI=y
CONFIG_TPC_PA_MAP=y
# end of Calibration

#
# ATE
#
CONFIG_ATE=y
# end of ATE

#
# BLE
#
CONFIG_BLE=n
# CONFIG_BLE_5_X is not set
CONFIG_BLE_4_2=y
# end of BLE

#
# Cli
#
CONFIG_CLI=y
CONFIG_BKREG=y
# CONFIG_TCP_SERVER_TEST is not set
# CONFIG_AIRKISS_TEST is not set
# CONFIG_WIFI_RAW_TX_TEST is not set
# CONFIG_I2C1_TEST is not set
# CONFIG_I2C2_TEST is not set
# CONFIG_UART_TEST is not set
# CONFIG_SPI_TEST is not set
# CONFIG_PERI_TEST is not set
# CONFIG_RF_OTA_TEST is not set
# end of Cli

#
# RF
#
CONFIG_RF_POLICY_BLE_REQ=y
# CONFIG_RF_POLICY_WIFI_REQ is not set
# CONFIG_RF_POLICY_CO_REQ is not set
# end of RF

#
# Internal Kconfig
#
CONFIG_CHECK_MISMATCH=y
CONFIG_MCU_PS=y
CONFIG_DEEP_PS=y
CONFIG_TICK_CALI=y
CONFIG_STA_PS=y
# end of Internal Kconfig

#
# FreeRTOS
#
CONFIG_FREERTOS=y
# CONFIG_LITEOS_M is not set
CONFIG_FREERTOS_V9=y
# CONFIG_FREERTOS_V10 is not set

#
# Memory Debug
#
# CONFIG_MALLOC_STATIS is not set
# CONFIG_MEM_DEBUG is not set
# end of Memory Debug
# end of FreeRTOS

#
# Startup
#
CONFIG_APP_MAIN_TASK_PRIO=4
CONFIG_APP_MAIN_TASK_STACK_SIZE=4096
# end of Startup

#
# System
#
# CONFIG_BASE_MAC_FROM_EFUSE is not set
CONFIG_BASE_MAC_FROM_RF_OTP_FLASH=y
# CONFIG_BASE_MAC_FROM_NVS is not set
# end of System

#
# USB configuration
#
# CONFIG_USB is not set
# end of USB configuration

#
# WiFi
#
# CONFIG_WIFI6_CODE_STACK is not set
CONFIG_WIFI4=y
CONFIG_MSDU_RESV_HEAD_LEN=96
CONFIG_MSDU_RESV_TAIL_LEN=16
CONFIG_TASK_RECONNECT_PRIO=4
# CONFIG_AP_MONITOR_COEXIST is not set
# CONFIG_WIFI_FAST_CONNECT is not set
# CONFIG_BSSID_CONNECT is not set
# CONFIG_WFA_CERT is not set
# CONFIG_LESS_MEMERY_IN_RWNX is not set
# CONFIG_AP_PROBEREQ_CB is not set
# end of WiFi

#
# BLE 4.2
#
# CONFIG_BLE_MESH is not set
CONFIG_BLE_PS=y
# end of BLE 4.2

# CONFIG_CAMERA is not set

#
# Driver
#

#
# Watchdog
#
CONFIG_INT_WDT=y
CONFIG_INT_WDT_PERIOD_MS=1000
CONFIG_TASK_WDT=y
CONFIG_TASK_WDT_PERIOD_MS=60000
# end of Watchdog

#
# UART
#
CONFIG_UART1=y
CONFIG_UART2=y
CONFIG_UART_ATE_PORT=1
# CONFIG_PRINT_PORT_UART1 is not set
CONFIG_PRINT_PORT_UART2=y
CONFIG_UART_PRINT_PORT=1
CONFIG_PRINTF_BUF_SIZE=128
# CONFIG_BACKGROUND_PRINT is not set
CONFIG_KFIFO_SIZE=128
# CONFIG_UART_STATIS is not set
# end of UART

#
# TRNG
#
CONFIG_TRNG_SUPPORT=y
# end of TRNG

#
# SDCARD
#
# CONFIG_SDCARD_HOST is not set
# end of SDCARD

CONFIG_MAC_PHY_BYPASS=y

#
# SDIO
#
# CONFIG_SDIO is not set
# end of SDIO

#
# SPI
#
# CONFIG_SPI_DMA is not set
# CONFIG_SPI_SLAVE is not set
# CONFIG_SPI_MASTER is not set
CONFIG_SPI_STATIS=y
CONFIG_SPI_SUPPORT_TX_FIFO_WR_READY=y
# CONFIG_HSLAVE_SPI is not set
# CONFIG_QSPI is not set
# CONFIG_SPI_MST_FLASH is not set
# CONFIG_SPI_MST_PSRAM is not set
# end of SPI

#
# DMA
#
CONFIG_GENERAL_DMA=y
# end of DMA

#
# JPEG
#
CONFIG_JPEG=y
# end of JPEG

#
# System control
#
# CONFIG_SYS_REDUCE_NORMAL_POWER is not set
# CONFIG_XTAL_FREQ_40M is not set
CONFIG_XTAL_FREQ_26M=y
CONFIG_XTAL_FREQ=26000000
CONFIG_DCO_FREQ=120000000
# end of System control

#
# PHY
#
# CONFIG_PTA is not set
# end of PHY

#
# I2S
#
# CONFIG_I2S is not set
# end of I2S

# CONFIG_SUPPORT_IRDA is not set
# CONFIG_MAILBOX is not set
# end of Driver

# CONFIG_EASY_FLASH is not set

#
# LwIP 2.0.2
#
CONFIG_LWIP=y
CONFIG_DHCP=y
CONFIG_TASK_LWIP_PRIO=4
CONFIG_LWIP_MEM_DEFAULT=y
# CONFIG_LWIP_MEM_REDUCE is not set
# end of LwIP 2.0.2

#
# LwIP 2.1.2
#
# end of LwIP 2.1.2

# CONFIG_MP3PLAYER is not set
# CONFIG_PCM_RESAMPLER is not set

#
# Power Save
#
# CONFIG_AP_IDLE is not set
# CONFIG_FAKE_RTC_PS is not set
# CONFIG_PM_MODEM_PWD is not set
# CONFIG_PM_STANDALONE is not set
# end of Power Save

#
# RF Test
#
CONFIG_TX_EVM_TEST=y
CONFIG_RX_SENSE_TEST=y
# end of RF Test

#
#config for p2p
#
CONFIG_WIFI_P2P=y
CONFIG_P2P=y
CONFIG_P2P_GO=y
CONFIG_WIFI_P2P_GO=y
#
#end of p2p

#
#config for wpa
#
CONFIG_WIFI_WPA=y
CONFIG_WPA2_ENTERPRISE=y
#
#end of wpa

#
#config p2p ps
CONFIG_USE_P2P_PS=y
CONFIG_TX_BUFING=y
#end of p2p ps


CONFIG_MAC_BSSID=y

#
#config wps
CONFIG_WIFI_WPS=y
CONFIG_WPS=y
#end of wps


#
# WiFi RWNX Interface
#
CONFIG_WIFI_KMSG_TASK_PRIO=3
CONFIG_WIFI_KMSG_TASK_STACK_SIZE=4096
CONFIG_WIFI_CORE_TASK_PRIO=2
CONFIG_WIFI_CORE_TASK_STACK_SIZE=2048
CONFIG_RWNX_QOS_MSDU=y
# end of WiFi RWNX Interface

# CONFIG_SARADC_CALI is not set
# CONFIG_SPIDMA is not set
# CONFIG_TEMP_DETECT is not set
# CONFIG_UART_DEBUG is not set
# CONFIG_UDISK_MP3 is not set
# CONFIG_WFA_CA is not set

#
# Supplicant
#
CONFIG_TASK_WPAS_PRIO=5
CONFIG_WPA3=y
CONFIG_WPA_CTRL_IFACE=y
# CONFIG_AP_HT_IE is not set
# CONFIG_WPA_LOG is not set
# end of Supplicant
# end of Components Configuration
# end of BDK Configuration
```

## middleware/arch/riscv/Kconfig
```kconfig
menu "ARCH_RISCV"
	config ARCH_RISCV
		bool "Enable RISCV"
		default n

	config NEST_INT_SUPPORT
		depends on ARCH_RISCV
		bool "Support nest interrupt"
		default n

endmenu
```

## middleware/compal/Kconfig
```kconfig
menu "HOME SYSTEM"

	config MATTER
		bool "Enable MATTER"
		default n

	config COMMON_IO
		depends on FREERTOS_V10
		bool "Amazon Common IO"
		default y
endmenu
```

## middleware/driver/Kconfig
```kconfig
#TODO optimize it
menu "Driver"

	menu "Watchdog"
		config INT_WDT
			bool "Enable Interrupt Watchdog"
			default y

		config INT_WDT_PERIOD_MS
			int "Interrupt Watchdog Period(ms)"
			default 1000

		config TASK_WDT
			bool "Enable Task Watchdog"
			default y

		config TASK_WDT_PERIOD_MS
			int "Interrupt Watchdog Period(ms)"
			default 60000
	endmenu

	menu "UART"
		config UART1
			bool "Enable UART1"
			default y
		config UART1_FLOW_CTRL
			bool "Uart1 Flow Ctrl"
			default n

		config UART2
			bool "Enable UART2"
			default y

		config UART3
			bool "Enable UART3"
			default n

		choice UART_PRINT_PORT
			prompt "Debug port"
			default PRINT_PORT_UART2

			config PRINT_PORT_UART1
				bool "UART1"
			config PRINT_PORT_UART2
				bool "UART2"
			config PRINT_PORT_UART3
				bool "UART3"
		endchoice

		config UART_PRINT_PORT
			int
			default 0 if PRINT_PORT_UART1
			default 1 if PRINT_PORT_UART2
			default 2 if PRINT_PORT_UART3

		config UART_ATE_PORT
			int "Config Uart ATE Port"
			range 0 2
			default 1
			help
			Default 1 mean use UART2

		config PRINTF_BUF_SIZE
			int "Print Buffer Size"
			range 1 4096
			default 128
			help
			The value should be changed if print size is more than 128

		# TODO do we need to put it to uart_debug component?
		config BACKGROUND_PRINT
			bool "Enable background print"
			default n

		config KFIFO_SIZE
			int "Kfifo Size"
			range 1 4096
			default 128
			help
				This will set kfifo size when software uses kfifo to cache data receiving.

		config UART_STATIS
			bool "Enable UART Statis"
			default n
	endmenu

	menu "TRNG"
		config TRNG_SUPPORT
			bool "Support hardware TRNG"
			default y
	endmenu

	menu "SDCARD"
		config SDCARD_HOST
			bool "Enable SDCARD Host"
			default y if (USB && USB_DEVICE)
			default n if !(USB && USB_DEVICE)

		choice SD_HOST_INTF
			prompt "SD Host Interface"
			depends on SDCARD_HOST
			default SD_HOST_INTF

			config SD_HOST_INTF
				bool "SD Host Interface"

			config SD1_HOST_INTF
				bool "SD1 Host Interface"
		endchoice

		config SDCARD_BUSWIDTH_4LINE
			bool "Support SDCARD 4 Data Wires"
			default n
	endmenu

	menu "FATFS"
		config FATFS
			bool "Support FATFS"
			default n
	endmenu

	config MAC_PHY_BYPASS
		bool "Enable MAC/PHY by pass mode"
		default y

	#TODO check SDIO configuration again
	menu "SDIO"
		config SDIO
			bool "Enable SDIO"
			default y if FULLY_HOSTED
			default n if !FULLY_HOSTED

		config SDIO_TRANS
			bool "Enable SDIO Trans"
			depends on SDIO
			default n

		config REAL_SDIO
			bool "Enable Real SDIO"
			depends on SDIO
			default y if FULLY_HOSTED
			default n if !FULLY_HOSTED

		config SDIO_BLOCK_512
			bool "Enable SDIO 512 Bytes Block"
			depends on REAL_SDIO
			default y if FULLY_HOSTED
			default n if !FULLY_HOSTED

	endmenu

	menu "SPI"
			#TODO optimize SPI_DMA and GENERAL_DMA when optimize driver
			config SPI_DMA
				bool "Enable SPI DMA"
				default y

			config SPI_SLAVE
				bool "Enable SPI Slave"
				default y

			config SPI_MASTER
				bool "Enable SPI Master"
				default y
			
			config SPI_STATIS
				bool "Enable SPI Statis"
				default y
			
			config SPI_SUPPORT_TX_FIFO_WR_READY
				bool "Support TX FIFO Write Ready"
				default y

			config HSLAVE_SPI
				bool "Enable HSlave SPI"
				default y

			config SPI_MST_FLASH
				bool "SPI MST Flash"
				default n

			config SPI_MST_PSRAM
				bool "SPI MST PSRAM"
				default n

	endmenu

	menu "QSPI"
			config QSPI
				bool "Enable QSPI"
				default n
			
			config QSPI_STATIS
				bool "Enable QSPI Statis"
				default y
	endmenu

	menu "AON_RTC"
			config AON_RTC
				bool "Enable AON_RTC"
				default n
			
			config AON_RTC_STATIS
				bool "Enable AON_RTC Statis"
				default n
	endmenu

	menu "DMA"
			config GENERAL_DMA
				bool "Enable General DMA"
				default y
	endmenu

	menu "TOUCH"
			config TOUCH
				bool "Enable TOUCH"
				default n
	endmenu
	
	menu "JPEG"
			config JPEG
				bool "Enable JPEG"
				default n
	endmenu
	
	menu "PSRAM"
			config PSRAM
				bool "Enable PSRAM"
				default n
	endmenu

	menu "System control"
		config SYS_REDUCE_NORMAL_POWER
		bool "Reduce system normal power"
		default n

		choice XTAL_FREQ
			prompt "Xtal frequence"
			default XTAL_FREQ_26M

			config XTAL_FREQ_40M
				bool "XTAL frequency 40M"

			config XTAL_FREQ_26M
				bool "XTAL frequency 26M"
		endchoice

		#TODO fixed it
		config XTAL_FREQ
			int "26000000"
			default 26000000 if XTAL_FREQ_26M
			default 40000000 if XTAL_FREQ_40M

		config DCO_FREQ
			int "DCO frequency"
			default 120000000
	endmenu

	menu "PHY"
		#TODO is here the right place to put CONFIG_PTA?
		config PTA
		bool "Enable PTA"
		default n
	endmenu

	menu "I2S"
		config I2S
		bool "Enable I2S"
		default n
	endmenu

	config SUPPORT_IRDA
		bool "Enable IRDA"
		default n

	config MAILBOX
		bool "Enable mail_box"
		default n

	config SYSTEM_CTRL
		bool "Enable system_ctrl"
		default n

	config VAULT
		bool "Enable secure vault"
		default n
		
	config LCD
		bool "Enable secure vault"
		default y

endmenu
```

## projects/examples/build_system/206_multi_sdkconfig/main/Kconfig.projbuild
```kconfig
menu "Example Product Configuration"

    config EXAMPLE_PRODUCT_NAME
        string "Product name"
        default "Not set"
        help
            Product name used in the example

    choice EXAMPLE_FUNC_IMPL
        prompt "Implementation of function 'func'"
        help
            Select one of the implementations of 'func' to be used in the app.
            This setting is used in component CMakeLists.txt.

        config MULTI_CONFIG_DEBUG
            bool "Development (func_dev.c)"
        config MULTI_CONFIG_RELEASE
            bool "Production (func_prod.c)"
    endchoice
endmenu
```

## projects/examples/build_system/206_multi_sdkconfig/sdkconfig.defaults
```kconfig
CONFIG_EXAMPLE_PRODUCT_NAME="Multiple sdkconfig example default"

# This selects 'func_dev.c' file to be compiled and linked, see CMakeLists.txt.
CONFIG_MULTI_CONFIG_DEBUG=y
```
