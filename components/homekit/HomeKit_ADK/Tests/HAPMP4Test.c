// Disclaimer: IMPORTANT: This Apple software is supplied to you, by Apple Inc. ("Apple"), in your
// capacity as a current, and in good standing, Licensee in the MFi Licensing Program. Use of this
// Apple software is governed by and subject to the terms and conditions of your MFi License,
// including, but not limited to, the restrictions specified in the provision entitled "Public
// Software", and is further subject to your agreement to the following additional terms, and your
// agreement that the use, installation, modification or redistribution of this Apple software
// constitutes acceptance of these additional terms. If you do not agree with these additional terms,
// you may not use, install, modify or redistribute this Apple software.
//
// Subject to all of these terms and in consideration of your agreement to abide by them, Apple grants
// you, for as long as you are a current and in good-standing MFi Licensee, a personal, non-exclusive
// license, under Apple's copyrights in this Apple software (the "Apple Software"), to use,
// reproduce, and modify the Apple Software in source form, and to use, reproduce, modify, and
// redistribute the Apple Software, with or without modifications, in binary form, in each of the
// foregoing cases to the extent necessary to develop and/or manufacture "Proposed Products" and
// "Licensed Products" in accordance with the terms of your MFi License. While you may not
// redistribute the Apple Software in source form, should you redistribute the Apple Software in binary
// form, you must retain this notice and the following text and disclaimers in all such redistributions
// of the Apple Software. Neither the name, trademarks, service marks, or logos of Apple Inc. may be
// used to endorse or promote products derived from the Apple Software without specific prior written
// permission from Apple. Except as expressly stated in this notice, no other rights or licenses,
// express or implied, are granted by Apple herein, including but not limited to any patent rights that
// may be infringed by your derivative works or by other works in which the Apple Software may be
// incorporated. Apple may terminate this license to the Apple Software by removing it from the list
// of Licensed Technology in the MFi License, or otherwise in accordance with the terms of such MFi License.
//
// Unless you explicitly state otherwise, if you provide any ideas, suggestions, recommendations, bug
// fixes or enhancements to Apple in connection with this software ("Feedback"), you hereby grant to
// Apple a non-exclusive, fully paid-up, perpetual, irrevocable, worldwide license to make, use,
// reproduce, incorporate, modify, display, perform, sell, make or have made derivative works of,
// distribute (directly or indirectly) and sublicense, such Feedback in connection with Apple products
// and services. Providing this Feedback is voluntary, but if you do provide Feedback to Apple, you
// acknowledge and agree that Apple may exercise the license granted above without the payment of
// royalties or further consideration to Participant.

// The Apple Software is provided by Apple on an "AS IS" basis. APPLE MAKES NO WARRANTIES, EXPRESS OR
// IMPLIED, INCLUDING WITHOUT LIMITATION THE IMPLIED WARRANTIES OF NON-INFRINGEMENT, MERCHANTABILITY
// AND FITNESS FOR A PARTICULAR PURPOSE, REGARDING THE APPLE SOFTWARE OR ITS USE AND OPERATION ALONE OR
// IN COMBINATION WITH YOUR PRODUCTS.
//
// IN NO EVENT SHALL APPLE BE LIABLE FOR ANY SPECIAL, INDIRECT, INCIDENTAL OR CONSEQUENTIAL DAMAGES
// (INCLUDING, BUT NOT LIMITED TO, PROCUREMENT OF SUBSTITUTE GOODS OR SERVICES; LOSS OF USE, DATA, OR
// PROFITS; OR BUSINESS INTERRUPTION) ARISING IN ANY WAY OUT OF THE USE, REPRODUCTION, MODIFICATION
// AND/OR DISTRIBUTION OF THE APPLE SOFTWARE, HOWEVER CAUSED AND WHETHER UNDER THEORY OF CONTRACT, TORT
// (INCLUDING NEGLIGENCE), STRICT LIABILITY OR OTHERWISE, EVEN IF APPLE HAS BEEN ADVISED OF THE
// POSSIBILITY OF SUCH DAMAGE.
//
// Copyright (C) 2015-2020 Apple Inc. All Rights Reserved.

#include "HAP.h"

#if HAP_FEATURE_ENABLED(HAP_FEATURE_CAMERA)

#include "HAPLogSubsystem.h"

static const HAPLogObject logObject = { .subsystem = kHAP_LogSubsystem ".Test", .category = "MP4" };

static uint8_t sps[] = { 0x27, 0x42, 0xe0, 0x1f, 0xa9, 0x18, 0x0a, 0x00, 0xb7, 0x60,
                         0x2d, 0x40, 0x80, 0x80, 0x8c, 0x2b, 0x5e, 0xf7, 0xc0, 0x40 };
static uint8_t pps[] = { 0x28, 0xde, 0x09, 0xc8 };
static const HAPFragmentedMP4RecordingConfiguration recConfig = {
    .video = {
        .type = kHAPFragmentedMP4VideoType_H264,
        .width = 1280,
        .height = 720,
        .timescale = 24000,
        .sps = {
            .bytes = sps,
            .numBytes = sizeof sps
        },
        .pps = {
            .bytes = pps,
            .numBytes = sizeof pps
        },
        .naluSizeBytes = 4,
    },
    .audio = {
        .type = kHAPFragmentedMP4AudioType_AAC_LC,
        .numberOfChannels = 1,
        .sampleRate = 44100,
        .bitRate = 128000
    }
};

static const HAPFragmentedMP4SampleDescriptor sampleDesc[30] = {
    { 0x0001893A, 1000, 1 }, { 0x000046A1, 1000, 0 }, { 0x00001FA3, 1000, 0 }, { 0x000047CB, 1000, 0 },
    { 0x00004013, 1000, 0 }, { 0x000048DE, 1000, 0 }, { 0x0000441B, 1000, 0 }, { 0x00005354, 1000, 0 },
    { 0x00004CE6, 1000, 0 }, { 0x000065CF, 1000, 0 }, { 0x000059EA, 1000, 0 }, { 0x00006405, 1000, 0 },
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    { 0x00006EC1, 1000, 0 }, { 0x000071C6, 1000, 0 }
};

static HAPFragmentedMP4RunDescriptor runDesc[1] = { { .trackType = kHAPFragmentedMP4TrackType_Video,
                                                      .decodeTime = 0,
                                                      .numSamples = HAPArrayCount(sampleDesc),
                                                      .sampleTable = sampleDesc,
                                                      .numRunDataBytes = 0x000C0283 - 8 } };

static const HAPFragmentedMP4FragmentConfiguration fragConfig = {
    .sequenceNumber = 1,
    .numRuns = 1,
    .run = runDesc,
};

static const uint8_t header[1116];
static const uint8_t fragment[344];

int main() {
    HAPError err;
    uint8_t buffer[2000];
    size_t numBytes, i;

    err = HAPFragmentedMP4WriteMovieHeader(&recConfig, buffer, sizeof buffer, &numBytes);
    HAPAssert(err == kHAPError_None);

    for (i = 0; i < numBytes && i < sizeof header; i++) {
        if (buffer[i] != header[i]) {
            HAPLogBufferInfo(&logObject, buffer, numBytes, "MP4 header.");
            HAPLogInfo(&logObject, "Error at 0x%lx", (unsigned long) i);
            HAPAssertionFailure();
        }
    }
    if (numBytes != sizeof header) {
        HAPLogInfo(&logObject, "Wrong header size: 0x%zx (0x%zx)", numBytes, sizeof header);
        HAPAssertionFailure();
    }

    err = HAPFragmentedMP4WriteMovieHeader(&recConfig, buffer, 1024, &numBytes);
    HAPAssert(err == kHAPError_OutOfResources);

    uint32_t size = 0;
    for (i = 0; i < HAPArrayCount(sampleDesc); i++) {
        size += sampleDesc[i].size;
    }
    HAPAssert(size == runDesc[0].numRunDataBytes);

    err = HAPFragmentedMP4WriteFragmentHeader(&fragConfig, buffer, sizeof buffer, &numBytes);
    HAPAssert(err == kHAPError_None);

    for (i = 0; i < numBytes && i < sizeof fragment; i++) {
        if (buffer[i] != fragment[i]) {
            HAPLogBufferInfo(&logObject, buffer, numBytes, "fragment header.");
            HAPLogInfo(&logObject, "Error at 0x%lx", (unsigned long) i);
            HAPAssertionFailure();
        }
    }
    if (numBytes != sizeof fragment) {
        HAPLogInfo(&logObject, "Wrong fragment size: 0x%zx (0x%zx)", numBytes, sizeof fragment);
        HAPAssertionFailure();
    }

    err = HAPFragmentedMP4WriteFragmentHeader(&fragConfig, buffer, 256, &numBytes);
    HAPAssert(err == kHAPError_OutOfResources);

    return 0;
}

static const uint8_t header[1116] = {
    0x00,
    0x00,
    0x00,
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    0x32,
    //  0x61, 0x76, 0x63, 0x31, 0x00, 0x00, 0x04, 0x4E, 0x6D, 0x6F, 0x6F, 0x76, // size
    0x61,
    0x76,
    0x63,
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    0xFF,
    //  0x00, 0x00, 0x01, 0xDE, 0x74, 0x72, 0x61, 0x6B, 0x00, 0x00, 0x00, 0x5C, // size
    0x00,
    0x00,
    0x01,
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    0x00,
    //  0x02, 0xD0, 0x00, 0x00, 0x00, 0x00, 0x01, 0x7A, 0x6D, 0x64, 0x69, 0x61, // size
    0x02,
    0xD0,
    0x00,
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    0xC0,
    //  0x00, 0x00, 0x00, 0x00, 0x15, 0xE0, 0x00, 0x00, 0x00, 0x00, 0x00, 0x35, // language = "und", size
    0x00,
    0x00,
    0x00,
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    0x00,
    //  0x00, 0x00, 0x00, 0x00, 0x42, 0x65, 0x6E, 0x74, 0x6F, 0x34, 0x20, 0x56, // remove "Bento4 "
    0x00,
    0x00,
    0x00,
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    0x00,
    //  0x01, 0xA4, 0x74, 0x72, 0x61, 0x6B, 0x00, 0x00, 0x00, 0x5C, 0x74, 0x6B, // size
    0x01,
    0x9D,
    0x74,
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    0x00,
    //  0x00, 0x00, 0x00, 0x00, 0x01, 0x40, 0x6D, 0x64, 0x69, 0x61, 0x00, 0x00, // size
    0x00,
    0x00,
    0x00,
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    0x00,
    //  0x00, 0x00, 0x15, 0xE0, 0x00, 0x00, 0x00, 0x00, 0x00, 0x35, 0x68, 0x64, // language = "und", size
    0x00,
    0x00,
    0x55,
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    0x00,
    //  0x00, 0x00, 0x42, 0x65, 0x6E, 0x74, 0x6F, 0x34, 0x20, 0x53, 0x6F, 0x75, // remove "Bento4 "
    0x00,
    0x00,
    0x53,
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    0x03,
    //  0x19, 0x00, 0x00, 0x00, 0x04, 0x11, 0x40, 0x15, 0x00, 0x18, 0x00, 0x00, // buffer size = 0
    0x19,
    0x00,
    0x00,
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    0x00,
    0x00
};

static const uint8_t fragment[344] = {
    0x00, 0x00, 0x01, 0x50, 0x6D, 0x6F, 0x6F, 0x66, 0x00, 0x00, 0x00, 0x10, 0x6D, 0x66, 0x68, 0x64, 0x00, 0x00, 0x00,
    0x00, 0x00, 0x00, 0x00, 0x01, 0x00, 0x00, 0x01, 0x38, 0x74, 0x72, 0x61, 0x66, 0x00, 0x00, 0x00, 0x14, 0x74, 0x66,
    0x68, 0x64, 0x00, 0x02, 0x00, 0x20, 0x00, 0x00, 0x00, 0x01, 0x01, 0x01, 0x00, 0x00, 0x00, 0x00, 0x00, 0x14, 0x74,
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    0x61, 0x74
};

#else

int main() {
    HAPLog(&kHAPLog_Default, "This test is not enabled. Please enable the Camera feature to run this test.");
    return 0;
}

#endif
