/* This file is generated by nds_ldsag (version (2021-07-02) ). */
ENTRY(_start)
SECTIONS
{
	PROVIDE (__executable_start = 0x00000000);
	NDS_SAG_LMA_CPU0 = 0x00000000 ;
	CPU0_BEGIN = NDS_SAG_LMA_CPU0;
	. = 0x00000000;
	.nds_vector 	: { *(.nds_vector ) }
	.interrupt.text 	: { KEEP(*(.interrupt.text )) }
	.interrupt.HalTrapVector.text.HalTrapVector 	: { KEEP(*(.interrupt.HalTrapVector.text.HalTrapVector )) }
	. = ALIGN(8);
	. = ALIGN(ALIGNOF(.nds32_init));
	.nds32_init 	: { KEEP(*(EXCLUDE_FILE (*txl_he.c.obj ).nds32_init )) } = 0x9200
	. = ALIGN(ALIGNOF(.interp));
	.interp 	: { *(EXCLUDE_FILE (*txl_he.c.obj ).interp ) }
	. = ALIGN(ALIGNOF(.note.gnu.build-id));
	.note.gnu.build-id 	: { *(EXCLUDE_FILE (*txl_he.c.obj ).note.gnu.build-id ) }
	. = ALIGN(ALIGNOF(.note.ABI-tag));
	.note.ABI-tag 	: { *(EXCLUDE_FILE (*txl_he.c.obj ).note.ABI-tag ) }
	. = ALIGN(ALIGNOF(.hash));
	.hash 	: { *(EXCLUDE_FILE (*txl_he.c.obj ).hash ) }
	. = ALIGN(ALIGNOF(.gnu.hash));
	.gnu.hash 	: { *(EXCLUDE_FILE (*txl_he.c.obj ).gnu.hash ) }
	. = ALIGN(ALIGNOF(.dynsym));
	.dynsym 	: { *(EXCLUDE_FILE (*txl_he.c.obj ).dynsym ) }
	. = ALIGN(ALIGNOF(.dynstr));
	.dynstr 	: { *(EXCLUDE_FILE (*txl_he.c.obj ).dynstr ) }
	. = ALIGN(ALIGNOF(.gnu.version));
	.gnu.version 	: { *(EXCLUDE_FILE (*txl_he.c.obj ).gnu.version ) }
	. = ALIGN(ALIGNOF(.gnu.version_d));
	.gnu.version_d 	: { *(EXCLUDE_FILE (*txl_he.c.obj ).gnu.version_d ) }
	. = ALIGN(ALIGNOF(.gnu.version_r));
	.gnu.version_r 	: { *(EXCLUDE_FILE (*txl_he.c.obj ).gnu.version_r ) }
	. = ALIGN(ALIGNOF(.rel.init));
	.rel.init 	: { *(EXCLUDE_FILE (*txl_he.c.obj ).rel.init ) }
	. = ALIGN(ALIGNOF(.rela.init));
	.rela.init 	: { *(EXCLUDE_FILE (*txl_he.c.obj ).rela.init ) }
	. = ALIGN(ALIGNOF(.rel.text));
	.rel.text 	: { *(EXCLUDE_FILE (*txl_he.c.obj ).rel.text EXCLUDE_FILE (*txl_he.c.obj ).rel.text.* EXCLUDE_FILE (*txl_he.c.obj ).rel.gnu.linkonce.t.* ) }
	. = ALIGN(ALIGNOF(.rela.text));
	.rela.text 	: { *(EXCLUDE_FILE (*txl_he.c.obj ).rela.text EXCLUDE_FILE (*txl_he.c.obj ).rela.text.* EXCLUDE_FILE (*txl_he.c.obj ).rela.gnu.linkonce.t.* ) }
	. = ALIGN(ALIGNOF(.rel.fini));
	.rel.fini 	: { *(EXCLUDE_FILE (*txl_he.c.obj ).rel.fini ) }
	. = ALIGN(ALIGNOF(.rela.fini));
	.rela.fini 	: { *(EXCLUDE_FILE (*txl_he.c.obj ).rela.fini ) }
	. = ALIGN(ALIGNOF(.rel.rodata));
	.rel.rodata 	: { *(EXCLUDE_FILE (*txl_he.c.obj ).rel.rodata EXCLUDE_FILE (*txl_he.c.obj ).rel.rodata.* EXCLUDE_FILE (*txl_he.c.obj ).rel.gnu.linkonce.r.* ) }
	. = ALIGN(ALIGNOF(.rela.rodata));
	.rela.rodata 	: { *(EXCLUDE_FILE (*txl_he.c.obj ).rela.rodata EXCLUDE_FILE (*txl_he.c.obj ).rela.rodata.* EXCLUDE_FILE (*txl_he.c.obj ).rela.gnu.linkonce.r.* ) }
	. = ALIGN(ALIGNOF(.rel.data.rel.ro));
	.rel.data.rel.ro 	: { *(EXCLUDE_FILE (*txl_he.c.obj ).rel.data.rel.ro* ) }
	. = ALIGN(ALIGNOF(.rela.data.rel.ro));
	.rela.data.rel.ro 	: { *(EXCLUDE_FILE (*txl_he.c.obj ).rel.data.rel.ro* ) }
	. = ALIGN(ALIGNOF(.rel.data));
	.rel.data 	: { *(EXCLUDE_FILE (*txl_he.c.obj ).rel.data EXCLUDE_FILE (*txl_he.c.obj ).rel.data.* EXCLUDE_FILE (*txl_he.c.obj ).rel.gnu.linkonce.d.* ) }
	. = ALIGN(ALIGNOF(.rela.data));
	.rela.data 	: { *(EXCLUDE_FILE (*txl_he.c.obj ).rela.data EXCLUDE_FILE (*txl_he.c.obj ).rela.data.* EXCLUDE_FILE (*txl_he.c.obj ).rela.gnu.linkonce.d.* ) }
	. = ALIGN(ALIGNOF(.rel.tdata));
	.rel.tdata 	: { *(EXCLUDE_FILE (*txl_he.c.obj ).rel.tdata EXCLUDE_FILE (*txl_he.c.obj ).rel.tdata.* EXCLUDE_FILE (*txl_he.c.obj ).rel.gnu.linkonce.td.* ) }
	. = ALIGN(ALIGNOF(.rela.tdata));
	.rela.tdata 	: { *(EXCLUDE_FILE (*txl_he.c.obj ).rela.tdata EXCLUDE_FILE (*txl_he.c.obj ).rela.tdata.* EXCLUDE_FILE (*txl_he.c.obj ).rela.gnu.linkonce.td.* ) }
	. = ALIGN(ALIGNOF(.rel.tbss));
	.rel.tbss 	: { *(EXCLUDE_FILE (*txl_he.c.obj ).rel.tbss EXCLUDE_FILE (*txl_he.c.obj ).rel.tbss.* EXCLUDE_FILE (*txl_he.c.obj ).rel.gnu.linkonce.tb.* ) }
	. = ALIGN(ALIGNOF(.rela.tbss));
	.rela.tbss 	: { *(EXCLUDE_FILE (*txl_he.c.obj ).rela.tbss EXCLUDE_FILE (*txl_he.c.obj ).rela.tbss.* EXCLUDE_FILE (*txl_he.c.obj ).rela.gnu.linkonce.tb.* ) }
	. = ALIGN(ALIGNOF(.rel.ctors));
	.rel.ctors 	: { *(EXCLUDE_FILE (*txl_he.c.obj ).rel.ctors ) }
	. = ALIGN(ALIGNOF(.rela.ctors));
	.rela.ctors 	: { *(EXCLUDE_FILE (*txl_he.c.obj ).rela.ctors ) }
	. = ALIGN(ALIGNOF(.rel.dtors));
	.rel.dtors 	: { *(EXCLUDE_FILE (*txl_he.c.obj ).rel.dtors ) }
	. = ALIGN(ALIGNOF(.rela.dtors));
	.rela.dtors 	: { *(EXCLUDE_FILE (*txl_he.c.obj ).rela.dtors ) }
	. = ALIGN(ALIGNOF(.rela.dyn));
	.rela.dyn 	: { *(EXCLUDE_FILE (*txl_he.c.obj )rela.dyn ) *(EXCLUDE_FILE (*txl_he.c.obj ).rela__libc_subfreeres ) *(EXCLUDE_FILE (*txl_he.c.obj ).rela__libc_atexit ) *(EXCLUDE_FILE (*txl_he.c.obj ).rela__libc_thread_subfreeres ) *(EXCLUDE_FILE (*txl_he.c.obj ).rela.init_array ) *(EXCLUDE_FILE (*txl_he.c.obj ).rela.fini_array ) }
	. = ALIGN(ALIGNOF(.rel.got));
	.rel.got 	: { *(EXCLUDE_FILE (*txl_he.c.obj ).rel.got ) }
	. = ALIGN(ALIGNOF(.rela.got));
	.rela.got 	: { *(EXCLUDE_FILE (*txl_he.c.obj ).rela.got ) }
	. = ALIGN(ALIGNOF(.rel.sdata));
	.rel.sdata 	: { *(EXCLUDE_FILE (*txl_he.c.obj ).rel.sdata EXCLUDE_FILE (*txl_he.c.obj ).rel.sdata.* EXCLUDE_FILE (*txl_he.c.obj ).rel.gnu.linkonce.s.* ) }
	. = ALIGN(ALIGNOF(.rela.sdata));
	.rela.sdata 	: { *(EXCLUDE_FILE (*txl_he.c.obj ).rela.sdata EXCLUDE_FILE (*txl_he.c.obj ).rela.sdata.* EXCLUDE_FILE (*txl_he.c.obj ).rela.gnu.linkonce.s.* ) }
	. = ALIGN(ALIGNOF(.rel.sbss));
	.rel.sbss 	: { *(EXCLUDE_FILE (*txl_he.c.obj ).rel.sbss EXCLUDE_FILE (*txl_he.c.obj ).rel.sbss.* EXCLUDE_FILE (*txl_he.c.obj ).rel.gnu.linkonce.sb.* ) }
	. = ALIGN(ALIGNOF(.rela.sbss));
	.rela.sbss 	: { *(EXCLUDE_FILE (*txl_he.c.obj ).rela.sbss EXCLUDE_FILE (*txl_he.c.obj ).rela.sbss.* EXCLUDE_FILE (*txl_he.c.obj ).rela.gnu.linkonce.sb.* ) }
	. = ALIGN(ALIGNOF(.rel.sdata2));
	.rel.sdata2 	: { *(EXCLUDE_FILE (*txl_he.c.obj ).rel.sdata2 EXCLUDE_FILE (*txl_he.c.obj ).rel.sdata2.* EXCLUDE_FILE (*txl_he.c.obj ).rel.gnu.linkonce.s2.* ) }
	. = ALIGN(ALIGNOF(.rela.sdata2));
	.rela.sdata2 	: { *(EXCLUDE_FILE (*txl_he.c.obj ).rela.sdata2 EXCLUDE_FILE (*txl_he.c.obj ).rela.sdata2.* EXCLUDE_FILE (*txl_he.c.obj ).rela.gnu.linkonce.s2.* ) }
	. = ALIGN(ALIGNOF(.rel.sbss2));
	.rel.sbss2 	: { *(EXCLUDE_FILE (*txl_he.c.obj ).rel.sbss2 EXCLUDE_FILE (*txl_he.c.obj ).rel.sbss2.* EXCLUDE_FILE (*txl_he.c.obj ).rel.gnu.linkonce.sb2.* ) }
	. = ALIGN(ALIGNOF(.rela.sbss2));
	.rela.sbss2 	: { *(EXCLUDE_FILE (*txl_he.c.obj ).rela.sbss2 EXCLUDE_FILE (*txl_he.c.obj ).rela.sbss2.* EXCLUDE_FILE (*txl_he.c.obj ).rela.gnu.linkonce.sb2.* ) }
	. = ALIGN(ALIGNOF(.rel.bss));
	.rel.bss 	: { *(EXCLUDE_FILE (*txl_he.c.obj ).rel.bss EXCLUDE_FILE (*txl_he.c.obj ).rel.bss.* EXCLUDE_FILE (*txl_he.c.obj ).rel.gnu.linkonce.b.* ) }
	. = ALIGN(ALIGNOF(.rela.bss));
	.rela.bss 	: { *(EXCLUDE_FILE (*txl_he.c.obj ).rela.bss EXCLUDE_FILE (*txl_he.c.obj ).rela.bss.* EXCLUDE_FILE (*txl_he.c.obj ).rela.gnu.linkonce.b.* ) }
	. = ALIGN(ALIGNOF(.rel.plt));
	.rel.plt 	: { *(EXCLUDE_FILE (*txl_he.c.obj ).rel.plt ) }
	. = ALIGN(ALIGNOF(.rela.plt));
	.rela.plt 	: { *(EXCLUDE_FILE (*txl_he.c.obj ).rela.plt ) }
	. = ALIGN(ALIGNOF(.init));
	.init 	: { KEEP(*(EXCLUDE_FILE (*txl_he.c.obj ).init )) }
	. = ALIGN(ALIGNOF(.plt));
	.plt 	: { *(EXCLUDE_FILE (*txl_he.c.obj ).plt ) }
	. = ALIGN(ALIGNOF(.text));
	.text 	: { *(EXCLUDE_FILE (*txl_he.c.obj ).text EXCLUDE_FILE (*txl_he.c.obj ).stub EXCLUDE_FILE (*txl_he.c.obj ).text.* EXCLUDE_FILE (*txl_he.c.obj ).gnu.linkonce.t.* ) KEEP(*(EXCLUDE_FILE (*txl_he.c.obj ).text.*personality* )) *(EXCLUDE_FILE (*txl_he.c.obj ).gnu.warning ) . = ALIGN(4); } = 0x9200
	. = ALIGN(ALIGNOF(.fini));
	.fini 	: { KEEP(*(EXCLUDE_FILE (*txl_he.c.obj ).fini )) }
	. = ALIGN(ALIGNOF(.ex9.itable));
	.ex9.itable 	: { *(EXCLUDE_FILE (*txl_he.c.obj ).ex9.itable ) }
	PROVIDE (__etext = .);
	PROVIDE (_etext = .);
	PROVIDE (etext = .);
	. = ALIGN(ALIGNOF(.rodata));
	.rodata 	: { *(EXCLUDE_FILE (*txl_he.c.obj ).rodata EXCLUDE_FILE (*txl_he.c.obj ).rodata.* EXCLUDE_FILE (*txl_he.c.obj ).gnu.linkonce.r.* ) }
	. = ALIGN(ALIGNOF(.rodata1));
	.rodata1 	: { *(EXCLUDE_FILE (*txl_he.c.obj ).rodata1 ) }
	. = ALIGN(ALIGNOF(.sdata2));
	.sdata2 	: { *(EXCLUDE_FILE (*txl_he.c.obj ).sdata2 EXCLUDE_FILE (*txl_he.c.obj ).sdata2.* EXCLUDE_FILE (*txl_he.c.obj ).gnu.linkonce.s2.* ) }
	. = ALIGN(ALIGNOF(.sbss2));
	.sbss2 	: { *(EXCLUDE_FILE (*txl_he.c.obj ).sbss2 EXCLUDE_FILE (*txl_he.c.obj ).sbss2.* EXCLUDE_FILE (*txl_he.c.obj ).gnu.linkonce.sb2.* ) }
	. = ALIGN(ALIGNOF(.eh_frame_hdr));
	.eh_frame_hdr 	: { *(EXCLUDE_FILE (*txl_he.c.obj ).eh_frame_hdr ) }
	. = ALIGN(8);
	. = ALIGN(8);
	. = ALIGN(8);
	. = ALIGN(8);
	. = 0x10000000;
	ITCM_BEGIN = .;
	. = ALIGN(8);
	. = ALIGN(ALIGNOF(".nds32_init_*txl_he.c.obj"));
	".nds32_init_*txl_he.c.obj" 	: AT(ALIGN(ALIGN(LOADADDR (.eh_frame_hdr) + SIZEOF (.eh_frame_hdr), ALIGNOF(".nds32_init_*txl_he.c.obj")), 8))
		{ KEEP(*txl_he.c.obj(.nds32_init )) } = 0x9200
	_itcm_lma_start =  LOADADDR (".nds32_init_*txl_he.c.obj");
	_itcm_ema_start = ADDR(".nds32_init_*txl_he.c.obj");
	. = ALIGN(ALIGNOF(".init_*txl_he.c.obj"));
	".init_*txl_he.c.obj" 	: AT(ALIGN(LOADADDR (".nds32_init_*txl_he.c.obj") + SIZEOF (".nds32_init_*txl_he.c.obj"), ALIGNOF(".init_*txl_he.c.obj")))
		{ KEEP(*txl_he.c.obj(.init )) }
	. = ALIGN(ALIGNOF(".plt_*txl_he.c.obj"));
	".plt_*txl_he.c.obj" 	: AT(ALIGN(LOADADDR (".init_*txl_he.c.obj") + SIZEOF (".init_*txl_he.c.obj"), ALIGNOF(".plt_*txl_he.c.obj")))
		{ *txl_he.c.obj(.plt ) }
	. = ALIGN(ALIGNOF(".text_*txl_he.c.obj"));
	".text_*txl_he.c.obj" 	: AT(ALIGN(LOADADDR (".plt_*txl_he.c.obj") + SIZEOF (".plt_*txl_he.c.obj"), ALIGNOF(".text_*txl_he.c.obj")))
		{ *txl_he.c.obj(.text .stub .text.* .gnu.linkonce.t.* ) KEEP(*txl_he.c.obj(.text.*personality* )) *txl_he.c.obj(.gnu.warning ) . = ALIGN(4); } = 0x9200
	. = ALIGN(ALIGNOF(".fini_*txl_he.c.obj"));
	".fini_*txl_he.c.obj" 	: AT(ALIGN(LOADADDR (".text_*txl_he.c.obj") + SIZEOF (".text_*txl_he.c.obj"), ALIGNOF(".fini_*txl_he.c.obj")))
		{ KEEP(*txl_he.c.obj(.fini )) }
	. = ALIGN(ALIGNOF(".ex9.itable_*txl_he.c.obj"));
	".ex9.itable_*txl_he.c.obj" 	: AT(ALIGN(LOADADDR (".fini_*txl_he.c.obj") + SIZEOF (".fini_*txl_he.c.obj"), ALIGNOF(".ex9.itable_*txl_he.c.obj")))
		{ *txl_he.c.obj(.ex9.itable ) }
	PROVIDE (__etext = .);
	PROVIDE (_etext = .);
	PROVIDE (etext = .);
	. = ALIGN(8);
	. = ALIGN(ALIGNOF(".nds32_init_*txl_agg.c.obj"));
	".nds32_init_*txl_agg.c.obj" 	: AT(ALIGN(ALIGN(LOADADDR (".ex9.itable_*txl_he.c.obj") + SIZEOF (".ex9.itable_*txl_he.c.obj"), ALIGNOF(".nds32_init_*txl_agg.c.obj")), 8))
		{ KEEP(*txl_agg.c.obj(.nds32_init )) } = 0x9200
	. = ALIGN(ALIGNOF(".init_*txl_agg.c.obj"));
	".init_*txl_agg.c.obj" 	: AT(ALIGN(LOADADDR (".nds32_init_*txl_agg.c.obj") + SIZEOF (".nds32_init_*txl_agg.c.obj"), ALIGNOF(".init_*txl_agg.c.obj")))
		{ KEEP(*txl_agg.c.obj(.init )) }
	. = ALIGN(ALIGNOF(".plt_*txl_agg.c.obj"));
	".plt_*txl_agg.c.obj" 	: AT(ALIGN(LOADADDR (".init_*txl_agg.c.obj") + SIZEOF (".init_*txl_agg.c.obj"), ALIGNOF(".plt_*txl_agg.c.obj")))
		{ *txl_agg.c.obj(.plt ) }
	. = ALIGN(ALIGNOF(".text_*txl_agg.c.obj"));
	".text_*txl_agg.c.obj" 	: AT(ALIGN(LOADADDR (".plt_*txl_agg.c.obj") + SIZEOF (".plt_*txl_agg.c.obj"), ALIGNOF(".text_*txl_agg.c.obj")))
		{ *txl_agg.c.obj(.text .stub .text.* .gnu.linkonce.t.* ) KEEP(*txl_agg.c.obj(.text.*personality* )) *txl_agg.c.obj(.gnu.warning ) . = ALIGN(4); } = 0x9200
	. = ALIGN(ALIGNOF(".fini_*txl_agg.c.obj"));
	".fini_*txl_agg.c.obj" 	: AT(ALIGN(LOADADDR (".text_*txl_agg.c.obj") + SIZEOF (".text_*txl_agg.c.obj"), ALIGNOF(".fini_*txl_agg.c.obj")))
		{ KEEP(*txl_agg.c.obj(.fini )) }
	. = ALIGN(ALIGNOF(".ex9.itable_*txl_agg.c.obj"));
	".ex9.itable_*txl_agg.c.obj" 	: AT(ALIGN(LOADADDR (".fini_*txl_agg.c.obj") + SIZEOF (".fini_*txl_agg.c.obj"), ALIGNOF(".ex9.itable_*txl_agg.c.obj")))
		{ *txl_agg.c.obj(.ex9.itable ) }
	PROVIDE (__etext = .);
	PROVIDE (_etext = .);
	PROVIDE (etext = .);
	. = ALIGN(8);
	. = ALIGN(ALIGNOF(".nds32_init_*txl_cntrl.c.obj"));
	".nds32_init_*txl_cntrl.c.obj" 	: AT(ALIGN(ALIGN(LOADADDR (".ex9.itable_*txl_agg.c.obj") + SIZEOF (".ex9.itable_*txl_agg.c.obj"), ALIGNOF(".nds32_init_*txl_cntrl.c.obj")), 8))
		{ KEEP(*txl_cntrl.c.obj(.nds32_init )) } = 0x9200
	. = ALIGN(ALIGNOF(".init_*txl_cntrl.c.obj"));
	".init_*txl_cntrl.c.obj" 	: AT(ALIGN(LOADADDR (".nds32_init_*txl_cntrl.c.obj") + SIZEOF (".nds32_init_*txl_cntrl.c.obj"), ALIGNOF(".init_*txl_cntrl.c.obj")))
		{ KEEP(*txl_cntrl.c.obj(.init )) }
	. = ALIGN(ALIGNOF(".plt_*txl_cntrl.c.obj"));
	".plt_*txl_cntrl.c.obj" 	: AT(ALIGN(LOADADDR (".init_*txl_cntrl.c.obj") + SIZEOF (".init_*txl_cntrl.c.obj"), ALIGNOF(".plt_*txl_cntrl.c.obj")))
		{ *txl_cntrl.c.obj(.plt ) }
	. = ALIGN(ALIGNOF(".text_*txl_cntrl.c.obj"));
	".text_*txl_cntrl.c.obj" 	: AT(ALIGN(LOADADDR (".plt_*txl_cntrl.c.obj") + SIZEOF (".plt_*txl_cntrl.c.obj"), ALIGNOF(".text_*txl_cntrl.c.obj")))
		{ *txl_cntrl.c.obj(.text .stub .text.* .gnu.linkonce.t.* ) KEEP(*txl_cntrl.c.obj(.text.*personality* )) *txl_cntrl.c.obj(.gnu.warning ) . = ALIGN(4); } = 0x9200
	. = ALIGN(ALIGNOF(".fini_*txl_cntrl.c.obj"));
	".fini_*txl_cntrl.c.obj" 	: AT(ALIGN(LOADADDR (".text_*txl_cntrl.c.obj") + SIZEOF (".text_*txl_cntrl.c.obj"), ALIGNOF(".fini_*txl_cntrl.c.obj")))
		{ KEEP(*txl_cntrl.c.obj(.fini )) }
	. = ALIGN(ALIGNOF(".ex9.itable_*txl_cntrl.c.obj"));
	".ex9.itable_*txl_cntrl.c.obj" 	: AT(ALIGN(LOADADDR (".fini_*txl_cntrl.c.obj") + SIZEOF (".fini_*txl_cntrl.c.obj"), ALIGNOF(".ex9.itable_*txl_cntrl.c.obj")))
		{ *txl_cntrl.c.obj(.ex9.itable ) }
	PROVIDE (__etext = .);
	PROVIDE (_etext = .);
	PROVIDE (etext = .);
	. = ALIGN(8);
	. = ALIGN(ALIGNOF(".nds32_init_*rxl_hwdesc.c.obj"));
	".nds32_init_*rxl_hwdesc.c.obj" 	: AT(ALIGN(ALIGN(LOADADDR (".ex9.itable_*txl_cntrl.c.obj") + SIZEOF (".ex9.itable_*txl_cntrl.c.obj"), ALIGNOF(".nds32_init_*rxl_hwdesc.c.obj")), 8))
		{ KEEP(*rxl_hwdesc.c.obj(.nds32_init )) } = 0x9200
	. = ALIGN(ALIGNOF(".init_*rxl_hwdesc.c.obj"));
	".init_*rxl_hwdesc.c.obj" 	: AT(ALIGN(LOADADDR (".nds32_init_*rxl_hwdesc.c.obj") + SIZEOF (".nds32_init_*rxl_hwdesc.c.obj"), ALIGNOF(".init_*rxl_hwdesc.c.obj")))
		{ KEEP(*rxl_hwdesc.c.obj(.init )) }
	. = ALIGN(ALIGNOF(".plt_*rxl_hwdesc.c.obj"));
	".plt_*rxl_hwdesc.c.obj" 	: AT(ALIGN(LOADADDR (".init_*rxl_hwdesc.c.obj") + SIZEOF (".init_*rxl_hwdesc.c.obj"), ALIGNOF(".plt_*rxl_hwdesc.c.obj")))
		{ *rxl_hwdesc.c.obj(.plt ) }
	. = ALIGN(ALIGNOF(".text_*rxl_hwdesc.c.obj"));
	".text_*rxl_hwdesc.c.obj" 	: AT(ALIGN(LOADADDR (".plt_*rxl_hwdesc.c.obj") + SIZEOF (".plt_*rxl_hwdesc.c.obj"), ALIGNOF(".text_*rxl_hwdesc.c.obj")))
		{ *rxl_hwdesc.c.obj(.text .stub .text.* .gnu.linkonce.t.* ) KEEP(*rxl_hwdesc.c.obj(.text.*personality* )) *rxl_hwdesc.c.obj(.gnu.warning ) . = ALIGN(4); } = 0x9200
	. = ALIGN(ALIGNOF(".fini_*rxl_hwdesc.c.obj"));
	".fini_*rxl_hwdesc.c.obj" 	: AT(ALIGN(LOADADDR (".text_*rxl_hwdesc.c.obj") + SIZEOF (".text_*rxl_hwdesc.c.obj"), ALIGNOF(".fini_*rxl_hwdesc.c.obj")))
		{ KEEP(*rxl_hwdesc.c.obj(.fini )) }
	. = ALIGN(ALIGNOF(".ex9.itable_*rxl_hwdesc.c.obj"));
	".ex9.itable_*rxl_hwdesc.c.obj" 	: AT(ALIGN(LOADADDR (".fini_*rxl_hwdesc.c.obj") + SIZEOF (".fini_*rxl_hwdesc.c.obj"), ALIGNOF(".ex9.itable_*rxl_hwdesc.c.obj")))
		{ *rxl_hwdesc.c.obj(.ex9.itable ) }
	PROVIDE (__etext = .);
	PROVIDE (_etext = .);
	PROVIDE (etext = .);
	_itcm_lma_end =  LOADADDR (".ex9.itable_*rxl_hwdesc.c.obj") + SIZEOF (".ex9.itable_*rxl_hwdesc.c.obj");
	_itcm_ema_end = .;
	ITCM_SIZE = . - ITCM_BEGIN;
	. = 0x20000000;
	DTCM_BEGIN = .;
	_dtcm_lma_end =  LOADADDR (".ex9.itable_*rxl_hwdesc.c.obj") + SIZEOF (".ex9.itable_*rxl_hwdesc.c.obj");
	_dtcm_ema_end = .;
	DTCM_SIZE = . - DTCM_BEGIN;
	. = 0x30000000;
	SRAM1_BEGIN = .;
	.bt_spec_data 	: AT(LOADADDR (".ex9.itable_*rxl_hwdesc.c.obj") + SIZEOF (".ex9.itable_*rxl_hwdesc.c.obj"))
		{ KEEP(*(.bt_spec_data )) }
	_dtcm_lma_start =  LOADADDR (.bt_spec_data);
	_dtcm_ema_start = ADDR(.bt_spec_data);
	_bt_data_lmastart =  LOADADDR (.bt_spec_data);
	_bt_data_start = ADDR(.bt_spec_data);
	_bt_data_end =  LOADADDR (.bt_spec_data) + SIZEOF (.bt_spec_data);
	SRAM1_SIZE = . - SRAM1_BEGIN;
	. = 0x30010000;
	SRAM2_BEGIN = .;
	. = ALIGN(8);
	. = ALIGN(0x20);
	. = ALIGN(ALIGNOF(.eh_frame));
	.eh_frame 	: AT(ALIGN(LOADADDR (.bt_spec_data) + SIZEOF (.bt_spec_data), 32))
		{ KEEP(*(.eh_frame )) }
	_data_lmastart =  LOADADDR (.eh_frame);
	_data_start = ADDR(.eh_frame);
	. = ALIGN(ALIGNOF(.gcc_except_table));
	.gcc_except_table 	: AT(ALIGN(LOADADDR (.eh_frame) + SIZEOF (.eh_frame), ALIGNOF(.gcc_except_table)))
		{ KEEP(*(.gcc_except_table )) *(.gcc_except_table.* ) }
	. = ALIGN(ALIGNOF(.tdata));
	.tdata 	: AT(ALIGN(LOADADDR (.gcc_except_table) + SIZEOF (.gcc_except_table), ALIGNOF(.tdata)))
		{ *(.tdata .tdata.* .gnu.linkonce.td.* ) }
	. = ALIGN(4);
	. = ALIGN(ALIGNOF(.preinit_array));
	.preinit_array 	: AT(ALIGN(ALIGN(LOADADDR (.tdata) + SIZEOF (.tdata), ALIGNOF(.preinit_array)), 4))
		{; PROVIDE (__preinit_array_start = .); KEEP(*(.preinit_array )); PROVIDE (__preinit_array_end = .); }
	. = ALIGN(ALIGNOF(.init_array));
	.init_array 	: AT(ALIGN(LOADADDR (.preinit_array) + SIZEOF (.preinit_array), ALIGNOF(.init_array)))
		{; PROVIDE (__init_array_start = .); KEEP(*(.init_array )); PROVIDE (__init_array_end = .); }
	. = ALIGN(ALIGNOF(.fini_array));
	.fini_array 	: AT(ALIGN(LOADADDR (.init_array) + SIZEOF (.init_array), ALIGNOF(.fini_array)))
		{; PROVIDE (__fini_array_start = .); KEEP(*(.fini_array )); PROVIDE (__fini_array_end = .); }
	. = ALIGN(ALIGNOF(.ctors));
	.ctors 	: AT(ALIGN(LOADADDR (.fini_array) + SIZEOF (.fini_array), ALIGNOF(.ctors)))
		{ KEEP(*crtbegin*.o(.ctors)) KEEP(*(EXCLUDE_FILE (*crtend*.o) .ctors)) KEEP(*(SORT(.ctors.* ))) KEEP(*(.ctors )) }
	. = ALIGN(ALIGNOF(.dtors));
	.dtors 	: AT(ALIGN(LOADADDR (.ctors) + SIZEOF (.ctors), ALIGNOF(.dtors)))
		{ KEEP(*crtbegin*.o(.dtors)) KEEP(*(EXCLUDE_FILE (*crtend*.o) .dtors)) KEEP(*(SORT(.dtors.* ))) KEEP(*(.dtors )) }
	. = ALIGN(ALIGNOF(.jcr));
	.jcr 	: AT(ALIGN(LOADADDR (.dtors) + SIZEOF (.dtors), ALIGNOF(.jcr)))
		{ KEEP(*(.jcr )) }
	. = ALIGN(ALIGNOF(.data.rel.ro));
	.data.rel.ro 	: AT(ALIGN(LOADADDR (.jcr) + SIZEOF (.jcr), ALIGNOF(.data.rel.ro)))
		{ *(.data.rel.ro.local ) *(.data.rel.ro* ) }
	. = ALIGN(ALIGNOF(.dynamic));
	.dynamic 	: AT(ALIGN(LOADADDR (.data.rel.ro) + SIZEOF (.data.rel.ro), ALIGNOF(.dynamic)))
		{ *(.dynamic ) }
	. = ALIGN(ALIGNOF(.data));
	.data 	: AT(ALIGN(LOADADDR (.dynamic) + SIZEOF (.dynamic), ALIGNOF(.data)))
		{ *(.data .data.* .gnu.linkonce.d.* ) KEEP(*(.gnu.linkonce.d.*personality* )) SORT(CONSTRUCTORS) . = ALIGN(8); }
	. = ALIGN(ALIGNOF(.data1));
	.data1 	: AT(ALIGN(LOADADDR (.data) + SIZEOF (.data), ALIGNOF(.data1)))
		{ *(.data1 ) . = ALIGN(8); }
	. = ALIGN(4);
	. = ALIGN(ALIGNOF(.got));
	.got 	: AT(ALIGN(ALIGN(LOADADDR (.data1) + SIZEOF (.data1), ALIGNOF(.got)), 4))
		{ *(.got.plt ) *(.got ) }
	. = ALIGN(ALIGNOF(.sdata));
	.sdata 	: AT(ALIGN(LOADADDR (.got) + SIZEOF (.got), ALIGNOF(.sdata)))
		{ *(.sdata .sdata.* .gnu.linkonce.s.* ) }
	. = ALIGN(ALIGNOF(.sdata_d));
	.sdata_d 	: AT(ALIGN(LOADADDR (.sdata) + SIZEOF (.sdata), ALIGNOF(.sdata_d)))
		{ *(.sdata_d .sdata_d.* ) }
	. = ALIGN(ALIGNOF(.sdata_w));
	.sdata_w 	: AT(ALIGN(LOADADDR (.sdata_d) + SIZEOF (.sdata_d), ALIGNOF(.sdata_w)))
		{ *(.sdata_w .sdata_w.* ) }
	. = ALIGN(ALIGNOF(.sdata_h));
	.sdata_h 	: AT(ALIGN(LOADADDR (.sdata_w) + SIZEOF (.sdata_w), ALIGNOF(.sdata_h)))
		{ *(.sdata_h .sdata_h.* ) }
	. = ALIGN(ALIGNOF(.sdata_b));
	.sdata_b 	: AT(ALIGN(LOADADDR (.sdata_h) + SIZEOF (.sdata_h), ALIGNOF(.sdata_b)))
		{ *(.sdata_b .sdata_b.* ) }
	. = ALIGN(ALIGNOF(.sdata_f));
	.sdata_f 	: AT(ALIGN(LOADADDR (.sdata_b) + SIZEOF (.sdata_b), ALIGNOF(.sdata_f)))
		{ *(.sdata_f .sdata_f.* ) }
	. = ALIGN(4);
	_edata = .;
	PROVIDE (edata = .);
	. = ALIGN(8);
	__bss_start = .;
	PROVIDE (__sbss_start = .);
	PROVIDE (___sbss_start = .);
	.tbss 	(NOLOAD)	: { *(.tbss .tbss.* .gnu.linkonce.tb.* ) *(.tcommon ) }
	.sbss 	(NOLOAD)	: { *(.dynsbss ) *(.sbss .sbss.* .gnu.linkonce.sb.* ) *(.scommon .scommon.* ) }
	.sbss_f 	(NOLOAD)	: { *(.sbss_f .sbss_f.* ) *(.scommon_f .scommon_f.* ) }
	.sbss_b 	(NOLOAD)	: { *(.sbss_b .sbss_b.* ) *(.scommon_b .scommon_b.* ) . = ALIGN(2); }
	.sbss_h 	(NOLOAD)	: { *(.sbss_h .sbss_h.* ) *(.scommon_h .scommon_h.* ) . = ALIGN(4); }
	.sbss_w 	(NOLOAD)	: { *(.sbss_w .sbss_w.* ) *(.scommon_w .scommon_w.* ) *(.dynsbss ) *(.scommon ) . = ALIGN(8); }
	.sbss_d 	(NOLOAD)	: { *(.sbss_d .sbss_d.* ) *(.scommon_d .scommon_d.* ) }
	.bss 	(NOLOAD)	: { *(.dynbss ) *(.bss .bss.* .gnu.linkonce.b.* ) *(COMMON ) . = ALIGN(4); }
	PROVIDE (__sbss_end = .);
	PROVIDE (___sbss_end = .);
	. = ALIGN(4);
	_end = .;
	PROVIDE (end = .);
	PROVIDE (_stack = 0x30058000);
	SRAM2_SIZE = . - SRAM2_BEGIN;
	CPU0_SIZE = LOADADDR(.sdata_f) + SIZEOF(.sdata_f) - CPU0_BEGIN;
	.stab	0 : { *(.stab) }
	.stabstr	0 : { *(.stabstr) }
	.stab.excl	0 : { *(.stab.excl) }
	.stab.exclstr	0 : { *(.stab.exclstr) }
	.stab.index	0 : { *(.stab.index) }
	.stab.indexstr	0 : { *(.stab.indexstr) }
	.note.nds32	0 : { *(.note.nds32) *(.note.nds32.*) }
	.comment	0 : { *(.comment) }
	.debug	0 : { *(.debug) }
	.line	0 : { *(.line) }
	.debug_srcinfo	0 : { *(.debug_srcinfo) }
	.debug_sfnames	0 : { *(.debug_sfnames) }
	.debug_aranges	0 : { *(.debug_aranges) }
	.debug_pubnames	0 : { *(.debug_pubnames) }
	.debug_info	0 : { *(.debug_info .gnu.linkonce.wi.*) }
	.debug_abbrev	0 : { *(.debug_abbrev) }
	.debug_line	0 : { *(.debug_line) }
	.debug_frame	0 : { *(.debug_frame) }
	.debug_str	0 : { *(.debug_str) }
	.debug_loc	0 : { *(.debug_loc) }
	.debug_macinfo	0 : { *(.debug_macinfo) }
	.debug_weaknames	0 : { *(.debug_weaknames) }
	.debug_funcnames	0 : { *(.debug_funcnames) }
	.debug_typenames	0 : { *(.debug_typenames) }
	.debug_varnames	0 : { *(.debug_varnames) }
}
ASSERT((DEFINED (_RELAX_END_) ? ITCM_SIZE : 0x0)<= 0x8000, "ITCM OVERFLOW");
ASSERT((DEFINED (_RELAX_END_) ? DTCM_SIZE : 0x0)<= 0x8000, "DTCM OVERFLOW");
ASSERT((DEFINED (_RELAX_END_) ? SRAM1_SIZE : 0x0)<= 0x10000, "SRAM1 OVERFLOW");
ASSERT((DEFINED (_RELAX_END_) ? SRAM2_SIZE : 0x0)<= 0x48000, "SRAM2 OVERFLOW");
ASSERT((DEFINED (_RELAX_END_) ? CPU0_SIZE : 0x0)<= 0x280000, "CPU0 OVERFLOW");
